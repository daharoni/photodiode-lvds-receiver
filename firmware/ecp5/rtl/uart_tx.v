// uart_tx.v : 8N1 UART transmitter.
// Parameters: CLK_HZ (clock frequency), BAUD. The bit period is generated by a
// phase accumulator (acc += BAUD each clock, a bit tick when acc >= CLK_HZ), so non-integer
// CLK_HZ/BAUD ratios (50 MHz / 3 Mbaud = 16.67 clocks per bit: 16 or 17, each bit within +-1 clock, mean exact) have no cumulative error; each bit is
// floor/ceil of the ideal length in clocks (at most 1 clock of jitter).
// Handshake: when ready=1, data is accepted on the clock edge where valid=1 (ready
// then drops until the stop bit has been sent). txd idles high. Synchronous active-high rst.
`default_nettype none

module uart_tx #(
    parameter CLK_HZ = 50_000_000,
    parameter BAUD   = 115_200
) (
    input  wire       clk,
    input  wire       rst,
    input  wire [7:0] data,
    input  wire       valid,
    output wire       ready,
    output reg        txd
);
    reg        busy;
    reg [3:0]  cnt;     // ticks left in the frame
    reg [8:0]  sh;
    reg [31:0] acc;

    wire [31:0] acc_n = acc + BAUD;
    wire        tick  = (acc_n >= CLK_HZ);

    assign ready = ~busy;

    always @(posedge clk) begin
        if (rst) begin
            busy <= 1'b0;
            txd  <= 1'b1;
            cnt  <= 4'd0;
            sh   <= 9'h1FF;
            acc  <= 32'd0;
        end else if (!busy) begin
            acc <= 32'd0;
            if (valid) begin
                busy <= 1'b1;
                txd  <= 1'b0;           // start bit
                sh   <= {1'b1, data};
                cnt  <= 4'd9;
            end
        end else begin
            acc <= tick ? (acc_n - CLK_HZ) : acc_n;
            if (tick) begin
                if (cnt == 4'd0) begin
                    busy <= 1'b0;       // stop bit complete
                end else begin
                    txd <= sh[0];       // d0..d7, then the stop bit (1)
                    sh  <= {1'b1, sh[8:1]};
                    cnt <= cnt - 4'd1;
                end
            end
        end
    end
endmodule
`default_nettype wire
